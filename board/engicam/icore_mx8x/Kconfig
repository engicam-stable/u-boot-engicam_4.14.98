## board/engicam/icore_mx8x/Kconfig
```kconfig
if TARGET_ICORE_MX8X

config SYS_BOARD
	default "icore_mx8x"

config SYS_VENDOR
	default "engicam"

config SYS_CONFIG_NAME
	default "icore_mx8x"

source "board/freescale/common/Kconfig"

endif
```

## board/engicam/icore_mx8xd/Kconfig
```kconfig
if TARGET_ICORE_MX8XD

config SYS_BOARD
	default "icore_mx8xd"

config SYS_VENDOR
	default "engicam"

config SYS_CONFIG_NAME
	default "icore_mx8xd"

source "board/freescale/common/Kconfig"

endif
```

## board/engicam/icoremx8m/Kconfig
```kconfig
if TARGET_ICOREMX8M

config SYS_BOARD
	default "icoremx8m"

config SYS_VENDOR
	default "engicam"

config SYS_CONFIG_NAME
	default "icoremx8m"

endif
```

## board/engicam/ultragea_mx8qm/Kconfig
```kconfig
if TARGET_ULTRAGEA_MX8QM

config SYS_BOARD
	default "ultragea_mx8qm"

config SYS_VENDOR
	default "engicam"

config SYS_CONFIG_NAME
	default "ultragea_mx8qm"

source "board/freescale/common/Kconfig"

endif
```
